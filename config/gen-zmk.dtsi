/ { combos { compatible = "zmk,combos"; combo_emk_3d { timeout-ms = <30>; bindings = <&kp EQUAL>; key-positions = <18 19>; layers = <0 1>; }; }; };
/ { combos { compatible = "zmk,combos"; combo_emk_7c { timeout-ms = <30>; bindings = <&kp PIPE>; key-positions = <21 22>; layers = <0 1>; }; }; };
/ { combos { compatible = "zmk,combos"; combo_emk_21 { timeout-ms = <30>; bindings = <&kp EXCL>; key-positions = <2 14>; layers = <0 1>; }; }; };
/ { combos { compatible = "zmk,combos"; combo_emk_40 { timeout-ms = <30>; bindings = <&kp AT>; key-positions = <2 3>; layers = <0 1>; }; }; };
/ { combos { compatible = "zmk,combos"; combo_emk_28 { timeout-ms = <30>; bindings = <&kp LPAR>; key-positions = <14 15>; layers = <0 1>; }; }; };
/ { combos { compatible = "zmk,combos"; combo_emk_29 { timeout-ms = <30>; bindings = <&kp RPAR>; key-positions = <15 16>; layers = <0 1>; }; }; };
/ { combos { compatible = "zmk,combos"; combo_emk_5b { timeout-ms = <30>; bindings = <&kp LBKT>; key-positions = <13 14>; layers = <0 1>; }; }; };
/ { combos { compatible = "zmk,combos"; combo_emk_5d { timeout-ms = <30>; bindings = <&kp RBKT>; key-positions = <16 17>; layers = <0 1>; }; }; };
/ { combos { compatible = "zmk,combos"; combo_emk_7b { timeout-ms = <30>; bindings = <&kp LBRC>; key-positions = <3 4>; layers = <0 1>; }; }; };
/ { combos { compatible = "zmk,combos"; combo_emk_7d { timeout-ms = <30>; bindings = <&kp RBRC>; key-positions = <4 5>; layers = <0 1>; }; }; };
/ { combos { compatible = "zmk,combos"; combo_emk_7e { timeout-ms = <30>; bindings = <&kp TILDE>; key-positions = <7 8>; layers = <0 1>; }; }; };
/ { combos { compatible = "zmk,combos"; combo_emk_25 { timeout-ms = <30>; bindings = <&kp PRCNT>; key-positions = <8 9>; layers = <0 1>; }; }; };
/ { combos { compatible = "zmk,combos"; combo_emk_2a { timeout-ms = <30>; bindings = <&kp STAR>; key-positions = <19 20>; layers = <0 1>; }; }; };
/ { combos { compatible = "zmk,combos"; combo_emk_2b { timeout-ms = <30>; bindings = <&kp PLUS>; key-positions = <20 21>; layers = <0 1>; }; }; };
/ { combos { compatible = "zmk,combos"; combo_emk_5e { timeout-ms = <30>; bindings = <&kp CARET>; key-positions = <9 21>; layers = <0 1>; }; }; };
/ { combos { compatible = "zmk,combos"; combo_emk_2d { timeout-ms = <18>; bindings = <&kp MINUS>; key-positions = <3 15>; layers = <0 1>; }; }; };
/ { combos { compatible = "zmk,combos"; combo_emk_5f { timeout-ms = <18>; bindings = <&kp UNDER>; key-positions = <4 16>; layers = <0 1>; }; }; };
/ { combos { compatible = "zmk,combos"; combo_emk_26 { timeout-ms = <18>; bindings = <&kp AMPS>; key-positions = <16 28>; layers = <0 1>; }; }; };
/ { combos { compatible = "zmk,combos"; combo_emk_23 { timeout-ms = <18>; bindings = <&kp HASH>; key-positions = <15 27>; layers = <0 1>; }; }; };
/ { combos { compatible = "zmk,combos"; combo_emk_24 { timeout-ms = <18>; bindings = <&kp DLLR>; key-positions = <17 29>; layers = <0 1>; }; }; };
/ { combos { compatible = "zmk,combos"; combo_emk_60 { timeout-ms = <18>; bindings = <&kp GRAVE>; key-positions = <19 31>; layers = <0 1>; }; }; };
/ { combos { compatible = "zmk,combos"; combo_emk_5c { timeout-ms = <18>; bindings = <&kp BSLH>; key-positions = <20 32>; layers = <0 1>; }; }; };
/ { combos { compatible = "zmk,combos"; combo_emk_27 { timeout-ms = <18>; bindings = <&kp SQT>; key-positions = <8 20>; layers = <0 1>; }; }; };
/ { combos { compatible = "zmk,combos"; combo_emk_22 { timeout-ms = <18>; bindings = <&kp DQT>; key-positions = <7 19>; layers = <0 1>; }; }; };
ZMK_BEHAVIOR(eme_432d6320702070, macro, bindings = <&kp LC(C) &kp P &kp P>; wait-ms = <0>; tap-ms = <5>;)
ZMK_BEHAVIOR(eme_432d6320702066, macro, bindings = <&kp LC(C) &kp P &kp F>; wait-ms = <0>; tap-ms = <5>;)
ZMK_BEHAVIOR(eme_432d782062, macro, bindings = <&kp LC(X) &kp B>; wait-ms = <0>; tap-ms = <5>;)
ZMK_BEHAVIOR(eme_432d782030, macro, bindings = <&kp LC(X) &kp N0>; wait-ms = <0>; tap-ms = <5>;)
ZMK_BEHAVIOR(eme_432d782031, macro, bindings = <&kp LC(X) &kp N1>; wait-ms = <0>; tap-ms = <5>;)
ZMK_BEHAVIOR(eme_432d782032, macro, bindings = <&kp LC(X) &kp N2>; wait-ms = <0>; tap-ms = <5>;)
ZMK_BEHAVIOR(eme_432d782033, macro, bindings = <&kp LC(X) &kp N3>; wait-ms = <0>; tap-ms = <5>;)
ZMK_UNICODE_PAIR(emu_3c93a9, N0, N3,  C, N9, N0, N3,  A, N9) // ω/Ω
ZMK_UNICODE_PAIR(emu_3b7397, N0, N3,  B, N7, N0, N3, N9, N7) // η/Η
ZMK_UNICODE_PAIR(emu_3f5395, N0, N3,  F, N5, N0, N3, N9, N5) // ϵ/Ε
ZMK_UNICODE_PAIR(emu_3c13a1, N0, N3,  C, N1, N0, N3,  A, N1) // ρ/Ρ
ZMK_UNICODE_PAIR(emu_3c43a4, N0, N3,  C, N4, N0, N3,  A, N4) // τ/Τ
ZMK_UNICODE_PAIR(emu_3b3393, N0, N3,  B, N3, N0, N3, N9, N3) // γ/Γ
ZMK_UNICODE_PAIR(emu_3c53a5, N0, N3,  C, N5, N0, N3,  A, N5) // υ/Υ
ZMK_UNICODE_PAIR(emu_3b9399, N0, N3,  B, N9, N0, N3, N9, N9) // ι/Ι
ZMK_UNICODE_PAIR(emu_3bf39f, N0, N3,  B,  F, N0, N3, N9,  F) // ο/Ο
ZMK_UNICODE_PAIR(emu_3c03a0, N0, N3,  C, N0, N0, N3,  A, N0) // π/Π
ZMK_UNICODE_PAIR(emu_3b1391, N0, N3,  B, N1, N0, N3, N9, N1) // α/Α
ZMK_UNICODE_PAIR(emu_3c33a3, N0, N3,  C, N3, N0, N3,  A, N3) // σ/Σ
ZMK_UNICODE_PAIR(emu_3b4394, N0, N3,  B, N4, N0, N3, N9, N4) // δ/Δ
ZMK_UNICODE_PAIR(emu_3c63a6, N0, N3,  C, N6, N0, N3,  A, N6) // φ/Φ
ZMK_UNICODE_PAIR(emu_3b8398, N0, N3,  B, N8, N0, N3, N9, N8) // θ/Θ
ZMK_UNICODE_PAIR(emu_3c73a7, N0, N3,  C, N7, N0, N3,  A, N7) // χ/Χ
ZMK_UNICODE_SINGLE(emu_d7, N0, N0,  D, N7) // ×
ZMK_UNICODE_PAIR(emu_3ba39a, N0, N3,  B,  A, N0, N3, N9,  A) // κ/Κ
ZMK_UNICODE_PAIR(emu_3bb39b, N0, N3,  B,  B, N0, N3, N9,  B) // λ/Λ
ZMK_UNICODE_PAIR(emu_3c83a8, N0, N3,  C, N8, N0, N3,  A, N8) // ψ/Ψ
ZMK_UNICODE_PAIR(emu_3b6396, N0, N3,  B, N6, N0, N3, N9, N6) // ζ/Ζ
ZMK_UNICODE_PAIR(emu_3be39e, N0, N3,  B,  E, N0, N3, N9,  E) // ξ/Ξ
ZMK_UNICODE_PAIR(emu_3b2392, N0, N3,  B, N2, N0, N3, N9, N2) // β/Β
ZMK_UNICODE_PAIR(emu_3bd39d, N0, N3,  B,  D, N0, N3, N9,  D) // ν/Ν
ZMK_UNICODE_PAIR(emu_3bc39c, N0, N3,  B,  C, N0, N3, N9,  C) // μ/Μ
ZMK_UNICODE_SINGLE(emu_211d, N2, N1, N1,  D) // ℝ
ZMK_UNICODE_SINGLE(emu_2295, N2, N2, N9, N5) // ⊕
ZMK_UNICODE_PAIR(emu_e8c9, N0, N0,  E, N8, N0, N0,  C, N9) // è/É
ZMK_UNICODE_PAIR(emu_e9c9, N0, N0,  E, N9, N0, N0,  C, N9) // é/É
ZMK_UNICODE_PAIR(emu_eaca, N0, N0,  E,  A, N0, N0,  C,  A) // ê/Ê
ZMK_UNICODE_PAIR(emu_f9d9, N0, N0,  F, N9, N0, N0,  D, N9) // ù/Ù
ZMK_UNICODE_PAIR(emu_eece, N0, N0,  E,  E, N0, N0,  C,  E) // î/Î
ZMK_UNICODE_PAIR(emu_153152, N0, N1, N5, N3, N0, N1, N5, N2) // œ/Œ
ZMK_UNICODE_PAIR(emu_e0c0, N0, N0,  E, N0, N0, N0,  C, N0) // à/À
ZMK_UNICODE_PAIR(emu_e2c2, N0, N0,  E, N2, N0, N0,  C, N2) // â/Â
ZMK_UNICODE_PAIR(emu_ebcb, N0, N0,  E,  B, N0, N0,  C,  B) // ë/Ë
ZMK_UNICODE_SINGLE(emu_20ac, N2, N0,  A,  C) // €
ZMK_UNICODE_PAIR(emu_fcdc, N0, N0,  F,  C, N0, N0,  D,  C) // ü/Ü
ZMK_UNICODE_PAIR(emu_efcf, N0, N0,  E,  F, N0, N0,  C,  F) // ï/Ï
ZMK_UNICODE_PAIR(emu_f4d4, N0, N0,  F, N4, N0, N0,  D, N4) // ô/Ô
ZMK_UNICODE_SINGLE(emu_2026, N2, N0, N2, N6) // …
ZMK_UNICODE_PAIR(emu_e7c7, N0, N0,  E, N7, N0, N0,  C, N7) // ç/Ç
ZMK_UNICODE_SINGLE(emu_ab, N0, N0,  A,  B) // «
ZMK_UNICODE_SINGLE(emu_bb, N0, N0,  B,  B) // »
ZMK_BEHAVIOR(eme_3a3d, macro, bindings = <&kp COLON &kp EQUAL>; wait-ms = <0>; tap-ms = <5>;)
/ {
  keymap {
    compatible = "zmk,keymap";
    layer_base {
      label = "base";
      bindings = <
  &to 6
  &kp Q
  &kp W
  &kp E
  &kp R
  &kp T
  &kp Y
  &kp U
  &kp I
  &kp O
  &kp P
  &sl 3
  &kp TAB
  &hll 5 A
  &hll 1 S
  &hml LCTRL D
  &hml LALT F
  &kp G
  &kp H
  &hmr LALT J
  &hmr LCTRL K
  &hlr 1 L
  &hhr 5 SEMI
  &sl 4
  &kp ESC
  &kp Z
  &kp X
  &kp C
  &kp V
  &kp B
  &kp N
  &kp M
  &kp COMMA
  &kp DOT
  &kp FSLH
  &kp RET
  &kp LGUI
  &kp LALT
  &mt_repeat LSHIFT BSPC
  &kp SPACE
  &mo 2
  &mo 1
      >;
    };
  };
};
/ {
  keymap {
    compatible = "zmk,keymap";
    layer_num {
      label = "num";
      bindings = <
  &none
  &kp EXCL
  &kp AT
  &kp UP
  &kp LBKT
  &kp RBKT
  &kp DQT
  &kp N7
  &kp N8
  &kp N9
  &kp STAR
  &none
  &none
  &kp HASH
  &kp LEFT
  &kp DOWN
  &kp RIGHT
  &kp DLLR
  &kp PG_UP
  &kp N4
  &kp N5
  &kp N6
  &eme_3a3d
  &none
  &none
  &kp LBKT
  &kp RBKT
  &kp LPAR
  &kp RPAR
  &kp AMPS
  &kp PG_DN
  &kp N1
  &kp N2
  &kp N3
  &kp BSLH
  &kp RET
  &none
  &none
  &none
  &none
  &kp N0
  &kp DOT
      >;
    };
  };
};
/ {
  keymap {
    compatible = "zmk,keymap";
    layer_fn {
      label = "fn";
      bindings = <
  &to 0
  &kp INS
  &kp HOME
  &kp UP
  &kp END
  &kp PG_UP
  &none
  &kp F7
  &kp F8
  &kp F9
  &kp F10
  &none
  &none
  &kp DEL
  &kp LEFT
  &kp DOWN
  &kp RIGHT
  &kp PG_DN
  &kp PG_UP
  &kp F4
  &kp F5
  &kp F6
  &kp F11
  &none
  &none
  &kp C_VOLUME_DOWN
  &kp C_VOLUME_UP
  &kp C_BRIGHTNESS_DEC
  &kp C_BRIGHTNESS_INC
  &none
  &kp PG_DN
  &kp F1
  &kp F2
  &kp F3
  &kp F12
  &none
  &none
  &to 0
  &none
  &none
  &to 0
  &kp PSCRN
      >;
    };
  };
};
/ {
  keymap {
    compatible = "zmk,keymap";
    layer_french {
      label = "french";
      bindings = <
  &none
  &none
  &emu_e8c9
  &emu_e9c9
  &emu_eaca
  &none
  &none
  &emu_f9d9
  &emu_eece
  &emu_153152
  &kp LS(ESC)
  &none
  &none
  &emu_e0c0
  &emu_e2c2
  &emu_ebcb
  &none
  &emu_20ac
  &none
  &emu_fcdc
  &emu_efcf
  &emu_f4d4
  &emu_2026
  &none
  &none
  &none
  &none
  &emu_e7c7
  &none
  &none
  &none
  &none
  &emu_ab
  &emu_bb
  &none
  &none
  &none
  &none
  &kp LSHIFT
  &none
  &to 0
  &none
      >;
    };
  };
};
/ {
  keymap {
    compatible = "zmk,keymap";
    layer_greek {
      label = "greek";
      bindings = <
  &none
  &emu_3c93a9
  &emu_3b7397
  &emu_3f5395
  &emu_3c13a1
  &emu_3c43a4
  &emu_3b3393
  &emu_3c53a5
  &emu_3b9399
  &emu_3bf39f
  &emu_3c03a0
  &none
  &none
  &emu_3b1391
  &emu_3c33a3
  &emu_3b4394
  &emu_3c63a6
  &emu_3b8398
  &emu_3c73a7
  &emu_d7
  &emu_3ba39a
  &emu_3bb39b
  &emu_3c83a8
  &none
  &none
  &emu_3b6396
  &emu_3be39e
  &none
  &emu_3c93a9
  &emu_3b2392
  &emu_3bd39d
  &emu_3bc39c
  &kp N
  &emu_211d
  &emu_2295
  &none
  &none
  &none
  &kp LSHIFT
  &none
  &to 0
  &none
      >;
    };
  };
};
/ {
  keymap {
    compatible = "zmk,keymap";
    layer_wm {
      label = "wm";
      bindings = <
  &none
  &none
  &none
  &kp LS(UP)
  &none
  &none
  &none
  &kp LG(J)
  &kp LG(K)
  &kp LG(L)
  &eme_432d6320702070
  &none
  &kp LG(TAB)
  &none
  &kp LS(LEFT)
  &kp LS(DOWN)
  &kp LS(RIGHT)
  &none
  &kp LG(RET)
  &kp LG(F)
  &kp LG(G)
  &kp LG(H)
  &eme_432d6320702066
  &none
  &none
  &none
  &kp LG(A)
  &kp LG(S)
  &kp LG(D)
  &eme_432d782062
  &eme_432d782030
  &eme_432d782031
  &eme_432d782032
  &eme_432d782033
  &none
  &none
  &none
  &none
  &none
  &kp LC(SPACE)
  &to 0
  &none
      >;
    };
  };
};
/ {
  keymap {
    compatible = "zmk,keymap";
    layer_mice {
      label = "mice";
      bindings = <
  &to 0
  &none
  &kp LA(LEFT)
  &kp UP
  &kp LA(RIGHT)
  &none
  &none
  &mkp LCLK
  &mmv MOVE_VERT(-1250)
  &mkp RCLK
  &none
  &none
  &to 7
  &none
  &kp LEFT
  &kp DOWN
  &kp RIGHT
  &kp PG_UP
  &mwh SCROLL_VERT(10)
  &mmv MOVE_HOR(-1250)
  &mmv MOVE_VERT(1250)
  &mmv MOVE_HOR(1250)
  &none
  &none
  &none
  &none
  &none
  &kp LCTRL
  &kp LALT
  &kp PG_DN
  &mwh SCROLL_VERT(-10)
  &mkp MCLK
  &none
  &none
  &none
  &kp RET
  &kp LGUI
  &none
  &kp LSHIFT
  &mkp LCLK
  &to 0
  &none
      >;
    };
  };
};
/ {
  keymap {
    compatible = "zmk,keymap";
    layer_sys {
      label = "sys";
      bindings = <
  &to 0
  &out OUT_TOG
  &none
  &none
  &none
  &none
  &none
  &none
  &none
  &none
  &none
  &none
  &to 0
  &none
  &none
  &none
  &none
  &none
  &none
  &bt BT_SEL 3
  &bt BT_SEL 4
  &none
  &none
  &none
  &none
  &none
  &none
  &none
  &none
  &bt BT_CLR
  &none
  &bt BT_SEL 0
  &bt BT_SEL 1
  &bt BT_SEL 2
  &none
  &none
  &none
  &none
  &none
  &none
  &to 0
  &none
      >;
    };
  };
};
