/*
 * Copyright (c) 2020 The ZMK Contributors
 * Copyright (c) 2023 Tristan de Cacqueray
 *
 * SPDX-License-Identifier: MIT
 */

#include <behaviors.dtsi>
#include <dt-bindings/zmk/keys.h>
#include <dt-bindings/zmk/outputs.h>
#include <dt-bindings/zmk/bt.h>
#include <dt-bindings/zmk/mouse.h>

// Force Linux unicode sequence
#define OS_UNICODE_LEAD &macro_tap &kp LS(LC(U))
#define OS_UNICODE_TRAIL &macro_tap &kp SPACE

#include "../zmk-nodefree-config/keypos_def/keypos_42keys.h"
#include "../zmk-nodefree-config/helper.h"

/* Homerow mods */
#define KEYS_L   LT0 LT1 LT2 LT3 LT4 LT5 LM0 LM1 LM2 LM3 LM4 LM5 LB0 LB1 LB2 LB3 LB4 LB5 // left hand
#define KEYS_R   RT0 RT1 RT2 RT3 RT4 RT5 RM0 RM1 RM2 RM3 RM4 RM5 RB0 RB1 RB2 RB3 RB4 RB5 // right hand
#define THUMBS   LH0 LH1 LH2 RH0 RH1 RH2                                                 // thumbs

#define QUICK_TAP_MS 240

// Home row mods
#define MAKE_HRM(NAME, FLAVOR, HOLD, TAP, TRIGGER_POS, HOOK) \
    ZMK_BEHAVIOR(NAME, hold_tap, \
        flavor = FLAVOR; \
        tapping-term-ms = <290>; \
        quick-tap-ms = <QUICK_TAP_MS>; \
        require-prior-idle-ms = <150>; \
        bindings = <HOLD>, <TAP>; \
        hold-trigger-key-positions = <TRIGGER_POS>; \
        HOOK \
    )
MAKE_HRM(hml, "balanced", &kp, &kp, KEYS_R THUMBS, hold-trigger-on-release;)  // left-hand HRMs
MAKE_HRM(hmr, "balanced", &kp, &kp, KEYS_L THUMBS, hold-trigger-on-release;)  // right-hand HRMs
MAKE_HRM(hll, "balanced", &mo, &kp, KEYS_R THUMBS, )   // left-hand Home Layer
MAKE_HRM(hlr, "balanced", &mo, &kp, KEYS_L THUMBS, )   // right-hand Home Layer
MAKE_HRM(hhr, "hold-preferred", &mo, &kp, KEYS_L THUMBS, )   // right-hand Home Layer

ZMK_BEHAVIOR(mt_repeat, hold_tap,         \
    flavor = "hold-preferred";            \
    tapping-term-ms = <QUICK_TAP_MS>;     \
    quick-tap-ms = <500>;                 \
    bindings = <&kp>, <&kp>;              \
)

&sl {
    release-after-ms = <2000>;
};

&mmv {
  acceleration-exponent = <1>;
  time-to-max-speed-ms = <400>;
  delay-ms = <0>;
};

&msc {
  acceleration-exponent = <1>;
  time-to-max-speed-ms = <40>;
  delay-ms = <0>;
};

#include "./gen-zmk.dtsi"
